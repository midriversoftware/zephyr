## boards/arm/delph301_nrf52840/Kconfig
```kconfig
# Delphian301 NRF52840 board configuration

config BOARD_ENABLE_DCDC
	bool "Enable DCDC mode"
	select SOC_DCDC_NRF52X
	default y
	depends on BOARD_DELPHIAN301_NRF52840
```

## boards/arm/delph301_nrf52840/Kconfig.board
```kconfig
# Delphian301 NRF52840 board configuration


config BOARD_DELPHIAN301_NRF52840
	bool "Delphian301 NRF52840"
	depends on SOC_NRF52840_QIAA
```

## boards/arm/delph301_nrf52840/Kconfig.defconfig
```kconfig
# Delphian301 NRF52840 board configuration

if BOARD_DELPHIAN301_NRF52840

config BOARD
	default "delph301_nrf52840"

if USB

config USB_NRFX
	default y

config USB_DEVICE_STACK
	default y

endif # USB

config BT_CTLR
	default BT

endif # BOARD_DELPHIAN301_NRF52840
```

## boards/arm/delph_nrf52840/Kconfig.board
```kconfig
# Delphian NRF52840 board configuration


config BOARD_DELPHIAN_NRF52840
	bool "Delphian NRF52840"
	depends on SOC_NRF52840_QIAA
```

## boards/arm/delph_nrf52840/Kconfig.defconfig
```kconfig
# Delphian NRF52840 board configuration

if BOARD_DELPHIAN_NRF52840

config BOARD
	default "delph_nrf52840"

if USB

config USB_NRFX
	default y

config USB_DEVICE_STACK
	default y

endif # USB

config BT_CTLR
	default BT

endif # BOARD_DELPHIAN_NRF52840
```

## drivers/eeprom/Kconfig.mct24aa64
```kconfig
# 
# 

config EEPROM_MCT24AA64
	bool "MCT24AA64 EEPROM driver"
	depends on SOC_SERIES_NRF52X
	default y
	help
	  Enable support for the EEPROM found on Delphian Bridge.
```

## dts/bindings/mtd/microchip,24aa64.yaml
```yaml
# 
# 
# Fields for MicroChip EEPROM devices

description: MicroChip 24AA64 EEPROM

compatible: "microchip,24aa64"

include: eeprom-base.yaml

properties:
    size:
      required: true
    pagesize:
      type: int
      required: true
      description: EEPROM page size in bytes
    address-width:
      type: int
      required: true
      description: EEPROM address width in bits
    timeout:
      type: int
      required: true
      description: EEPROM write cycle timeout in milliseconds
```
